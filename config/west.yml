## config/west.yml
```yaml
manifest:
  defaults:
    revision: v0.2
  remotes:
    - name: zmkfirmware
      url-base: https://github.com/zmkfirmware
    - name: mctechnology17
      url-base: https://github.com/mctechnology17
  projects:
    - name: zmk
      remote: zmkfirmware
      import: app/west.yml
    # support nice_oled and nice_epaper
    - name: zmk-dongle-display-view # <--- ADD THIS BLOCK
      remote: mctechnology17
      revision: main
  self:
    path: config
```
